## sdkconfig.defaults
```kconfig
# System
CONFIG_ESP32_DEFAULT_CPU_FREQ_240=y
CONFIG_ESPTOOLPY_FLASHSIZE_4MB=y
CONFIG_ESP_SYSTEM_PANIC_GDBSTUB=y
CONFIG_ESP_MAIN_TASK_STACK_SIZE=5120
CONFIG_LOG_COLORS=n

# WebServer
CONFIG_ESP_NETIF_TCPIP_ADAPTER_COMPATIBLE_LAYER=n
CONFIG_HTTPD_WS_SUPPORT=y
```
